/*
 * Copyright (c) 2024 The ZMK Contributors
 *
 * SPDX-License-Identifier: MIT
 */

#include <dt-bindings/zmk/keys.h>
/* #include <dt-bindings/zmk/behaviors.h> */
/*
 * Copyright (c) 2024 The ZMK Contributors
 *
 * SPDX-License-Identifier: MIT
 */

#define ZMK_BEHAVIOR_OMIT(_name)                                                                   \
    !(defined(ZMK_BEHAVIORS_KEEP_##_name) ||                                                       \
      (defined(ZMK_BEHAVIORS_KEEP_ALL) && !defined(ZMK_BEHAVIORS_OMIT_##_name)))

/ {
    behaviors {
#if ZMK_BEHAVIOR_OMIT(NUM_WORD)
        /omit-if-no-ref/
#endif
        num_word: num_word {
            compatible = "zmk,behavior-auto-layer";
            #binding-cells = <1>;
            continue-list = <BACKSPACE DELETE DOT COMMA PLUS MINUS STAR FSLH EQUAL>;
            ignore-numbers;
        };
    };
};
